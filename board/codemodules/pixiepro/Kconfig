## board/codemodules/pixiepro/Kconfig
```kconfig
if TARGET_PIXIEPRO

config SYS_BOARD
	default "pixiepro"

config SYS_VENDOR
	default "codemodules"

config SYS_CONFIG_NAME
	default "pixiepro"

config PIXIEPRO_EMMCTARGET
	bool "Is target eMMC?"

endif
```

## configs/pixieproqp_defconfig
```kconfig
CONFIG_SYS_EXTRA_OPTIONS="IMX_CONFIG=board/codemodules/pixiepro/pixieproqp.cfg,MX6QP"
CONFIG_DEFAULT_DEVICE_TREE="imx6qp-pixiepro"

CONFIG_ARM=y
CONFIG_ARCH_MX6=y
CONFIG_TARGET_PIXIEPRO=y
CONFIG_OF_LIBFDT=y
CONFIG_DEFAULT_FDT_FILE="/boot/imx6-pixiepro.dtb"
CONFIG_CMD_BOOTZ=y
CONFIG_HUSH_PARSER=y
CONFIG_IMX_THERMAL=y
CONFIG_CMD_MEMTEST=y
CONFIG_CMD_MEMINFO=y
CONFIG_CMD_MMC=y
CONFIG_CMD_SF=y
CONFIG_CMD_I2C=y
CONFIG_CMD_USB=y
CONFIG_CMD_DFU=y
CONFIG_CMD_USB_MASS_STORAGE=y
CONFIG_CMD_GPIO=y
CONFIG_CMD_DHCP=y
CONFIG_CMD_MII=y
CONFIG_CMD_PING=y
CONFIG_CMD_CACHE=y
CONFIG_CMD_EXT2=y
CONFIG_CMD_EXT4=y
CONFIG_CMD_EXT4_WRITE=y
CONFIG_CMD_FAT=y
CONFIG_CMD_FS_GENERIC=y
CONFIG_CMD_AES=y
CONFIG_CMD_NET=y
CONFIG_CMD_BMODE=y
CONFIG_ENV_IS_IN_MMC=y
CONFIG_OF_CONTROL=y
CONFIG_DFU_MMC=y
CONFIG_DFU_SF=y
CONFIG_DFU_RAM=y
CONFIG_SPI_FLASH=y
CONFIG_SPI_FLASH_STMICRO=y
CONFIG_USB=y
CONFIG_USB_EHCI=y
CONFIG_USB_STORAGE=y
CONFIG_USB_GADGET=y
CONFIG_USB_ETHER=y
CONFIG_USB_ETH_CDC=y
CONFIG_CI_UDC=y
CONFIG_FEC_MXC=y
CONFIG_SYS_TEXT_BASE=0x17800000
CONFIG_USB_GADGET_DOWNLOAD=y
CONFIG_G_DNL_MANUFACTURER="FSL"
CONFIG_G_DNL_VENDOR_NUM=0x0525
CONFIG_G_DNL_PRODUCT_NUM=0xa4a5
CONFIG_STACKSIZE=0x20000
# CONFIG_VIDEO_SW_CURSOR is not set
CONFIG_SYS_CONSOLE_IS_IN_ENV=y
CONFIG_SYS_CONSOLE_OVERWRITE_ROUTINE=y
```
